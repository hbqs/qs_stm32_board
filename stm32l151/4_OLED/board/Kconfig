## stm32l151/4_OLED/board/Kconfig
```kconfig
menu "Hardware Drivers Config"

config SOC_STM32L151RC
    bool
    select SOC_SERIES_STM32L1
    default y

menu "On-chip Peripheral Drivers"

    config BSP_USING_GPIO
        bool "Enable GPIO"
        select RT_USING_PIN
        default y

    menuconfig BSP_USING_UART
        bool "Enable UART"
        default y
        select RT_USING_SERIAL
        if BSP_USING_UART
            config BSP_USING_UART1
                bool "Enable UART1"
                default y

            config BSP_UART1_RX_USING_DMA
                bool "Enable UART1 RX DMA"
                depends on BSP_USING_UART1 && RT_SERIAL_USING_DMA
                default n
				
			config BSP_USING_UART2
                bool "Enable UART2"
                default y
				
			config BSP_USING_UART3
                bool "Enable UART3"
                default y
        endif

    menuconfig BSP_USING_I2C1
        bool "Enable I2C1 BUS (software simulation)"
        default n
        select RT_USING_I2C
        select RT_USING_I2C_BITOPS
        select RT_USING_PIN
        if BSP_USING_I2C1
            config BSP_I2C1_SCL_PIN
                int "i2c1 scl pin number"
                range 1 216
                default 26
            config BSP_I2C1_SDA_PIN
                int "I2C1 sda pin number"
                range 1 216
                default 27
        endif
		
	config BSP_USING_ONCHIP_RTC
        bool "Enable RTC"
        select RT_USING_RTC
        select RT_USING_LIBC
        default n	

endmenu

menu "Board extended module qsdk Drivers"
	config BSP_USING_LED
                bool "Enable LED"
                default n
				
	config BSP_USING_BEEP
                bool "Enable BEEP"
                default n
				
	config BSP_USING_KEY
                bool "Enable KEY"
                default n
				
	config BSP_USING_OLED
                bool "Enable OLED"
                default n
endmenu

endmenu
```
